VERSION ""

NS_ :

BS_:

BU_: ECU Debugger ACU TCM Dash_Panel Steering_Wheel DTI_Inverter GR_Inverter_1 GR_Inverter_2 GR_Inverter_3 GR_Inverter_4 Charging_SDC Fan_Controller_1 Fan_Controller_2 Fan_Controller_3 Fan_Controller_4 Fan_Controller_5 Fan_Controller_6 Fan_Controller_7 Fan_Controller_8 SAM1 SAM2 SAM3 SAM4 SAM5 SAM6 SAM7 SAM8 SAM9 SAM10 SAM11 SAM12 SAM13 SAM14 SAM15 SAM16 SAM17 SAM18 SAM19 SAM20 LV_DC_DC

BO_ 2147483648 Ping: 8 ECU
 SG_ Millis : 7|32@0- (1,0) [-214748.3648|214748.3647] "ms" Vector__XXX

BA_DEF_ BO_  "CANFD_BRS" ENUM  "0","1";
BA_DEF_  "DBName" STRING ;
BA_DEF_  "BusType" STRING ;
BA_DEF_ BO_  "VFrameFormat" ENUM  "StandardCAN","ExtendedCAN","reserved","reserved","reserved","reserved","reserved","reserved","reserved","reserved","reserved","reserved","reserved","reserved","StandardCAN_FD","ExtendedCAN_FD";
BA_DEF_DEF_  "CANFD_BRS" "1";
BA_DEF_DEF_  "DBName" "";
BA_DEF_DEF_  "BusType" "";
BA_DEF_DEF_  "VFrameFormat" "StandardCAN";
BA_ "BusType" "CAN FD";
BA_ "DBName" "CAN_DBC";
BA_ "VFrameFormat" BO_ 2147483648 1;
